## main/Kconfig.projbuild
```kconfig
menu "K-Line OBD"

    choice VEMS_BOARD
        prompt "Kart"
        default VEMS_BOARD_WAVESHARE_LCD21
        help
            Pin varsayilanlarini ve gosterimi (kart ekrani ya da Bluetooth telefon paneli) secer.

        config VEMS_BOARD_WAVESHARE_LCD21
            bool "Waveshare ESP32-S3-Touch-LCD-2.1 (yuvarlak ekran, K-Line UART basliginda)"
        config VEMS_BOARD_YD_ESP32_23
            bool "YD-ESP32-23 / ESP32-S3-DevKitC-1 (ekransiz, Bluetooth telefon paneli)"
    endchoice

    menu "OBD-II K-Line"

        config VEMS_OBD_KLINE_UART_PORT
            int "K-Line UART port numarasi"
            range 1 2
            default 1

        config VEMS_OBD_KLINE_TX_GPIO
            int "K-Line TX GPIO -> L9637D TX"
            default 17 if VEMS_BOARD_YD_ESP32_23
            default 44
            help
                Waveshare: disariya acik serbest pinler sadece UART basligi (GPIO43/44). Baslik yazilari
                capraz: RXD = GPIO44 = bizim TX. "UART" Type-C takiliyken kart uzerindeki anahtar bu
                pinleri CH343'e verir: K-Line calismaz, kart "USB" Type-C'den beslenmeli.
                YD-ESP32-23: sol siradaki GPIO17 (UART1 varsayilan TX), yazilar capraz degil.

        config VEMS_OBD_KLINE_RX_GPIO
            int "K-Line RX GPIO <- L9637D RX"
            default 18 if VEMS_BOARD_YD_ESP32_23
            default 43

        config VEMS_ENGINE_CC
            int "Motor hacmi (cc), MAF yoksa yakit tuketimi tahmini icin"
            range 500 8000
            default 1399
            help
                Kalos 1.4 16V (F14D3) = 1399 cc. MAF sensoru olmayan araclarda tuketim MAP, emme havasi
                ve devirden hesaplanir (hiz-yogunluk, dolum verimi %80 varsayilir).

    endmenu

    config VEMS_PRINT_INTERVAL_MS
        int "Konsola yazdirma araligi (ms, 0 = kapali)"
        range 0 10000
        default 250

    config VEMS_PRINT_JSON
        bool "Canli veriyi JSON satiri olarak da yazdir"
        default n

    config VEMS_UI_ENABLE
        bool "Waveshare 2.1\" yuvarlak ekranda gosterge paneli"
        depends on VEMS_BOARD_WAVESHARE_LCD21
        default y
        help
            Waveshare ESP32-S3-Touch-LCD-2.1 karti icin.

    config VEMS_BLE_PANEL
        bool "Bluetooth (BLE) telefon paneli"
        depends on BT_NIMBLE_ENABLED
        default y if VEMS_BOARD_YD_ESP32_23
        help
            Android Chrome, GitHub Pages'teki panel.html sayfasindan Web Bluetooth ile baglanir.
            Canli veri, acilis adimlari ve ariza kodlari telefonda gorunur. BT_NIMBLE_ENABLED gerekir
            (sdkconfig.defaults.yd acar).

    config VEMS_BLE_NAME
        string "Bluetooth cihaz adi"
        depends on VEMS_BLE_PANEL
        default "K-Line-OBD"

    config VEMS_UI_RPM_MAX
        int "Devir gostergesi maksimum (RPM)"
        depends on VEMS_UI_ENABLE
        range 4000 12000
        default 8000

    config VEMS_UI_RPM_SHIFT
        int "Kirmizi bolge / vites uyari devri (RPM)"
        depends on VEMS_UI_ENABLE
        range 2000 12000
        default 6500

    config VEMS_UI_BACKLIGHT
        int "Ekran parlakligi (%)"
        depends on VEMS_UI_ENABLE
        range 5 100
        default 80

    choice VEMS_UI_FUEL
        prompt "Yakit tipi (AFR = lambda x stokiyometrik)"
        depends on VEMS_UI_ENABLE
        default VEMS_UI_FUEL_GASOLINE

        config VEMS_UI_FUEL_GASOLINE
            bool "Benzin (14.7)"
        config VEMS_UI_FUEL_E85
            bool "E85 (9.8)"
        config VEMS_UI_FUEL_LPG
            bool "LPG (15.5)"
        config VEMS_UI_FUEL_METHANOL
            bool "Metanol (6.4)"
    endchoice

    config VEMS_UI_SPLASH_MIN_MS
        int "Acilis ekrani minimum suresi (ms)"
        depends on VEMS_UI_ENABLE
        range 0 10000
        default 2500

    config VEMS_UI_SPLASH_TIMEOUT_MS
        int "ECU bulunamazsa acilis ekranindan cikis (ms)"
        depends on VEMS_UI_ENABLE
        range 2000 60000
        default 12000

    config VEMS_UI_BOOT_BEEP
        bool "Acilista buzzer melodisi (yaris baslangic isiklari)"
        depends on VEMS_UI_ENABLE
        default y

endmenu
```
